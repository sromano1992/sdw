#include <UTFT.h>
#include <UTouch.h>
#include <SoftwareSerial.h>
#include <avr/pgmspace.h>  //for image
prog_uint16_t _home[0x310] PROGMEM ={
  0xFFFF, 0xFFFF, 0xFFFF, 0xFFFF, 0xFFFF, 0xFFFF, 0xFFFF, 0xFFFF, 0xFFFF, 0xFFFF, 0xFFFF, 0xFFFF, 0xFFFF, 0xFFFF, 0xFFFF, 0xFFFF,   // 0x0010 (16)
  0xFFFF, 0xFFFF, 0xFFFF, 0xFFFF, 0xFFFF, 0xFFFF, 0xFFFF, 0xFFFF, 0xFFFF, 0xFFFF, 0xFFFF, 0xFFFF, 0xFFFF, 0xFFFF, 0xFFFF, 0xFFFF,   // 0x0020 (32)
  0xFFFF, 0xFFFF, 0xFFFF, 0xFFFF, 0xFFFF, 0xFFFF, 0xFFFF, 0xFFFF, 0xFFFF, 0xFFFF, 0xFFFF, 0xFFFF, 0xFFFF, 0xFFFF, 0xFFFF, 0xFFFF,   // 0x0030 (48)
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  0xFFFF, 0xFFFF, 0xFFFF, 0xFFFF, 0xFFFF, 0xFFFF, 0xFFFF, 0xFFFF, 0xFFFF, 0xFFFF, 0xFFFF, 0xFFFF, 0xFFFF, 0xFFFF, 0xFFFF, 0xFFFF,   // 0x0310 (784)
};

/*
 Number 14 to 19 refers to A0 to A5
 Number 0 to 13 refers to digital pin 0 to 13
 */
UTFT        myGLCD(ITDB24D ,19,18,17,16);  //Relative tft pin: RS, WR, CS, RESET
UTouch      myTouch(15,10,14,9,8);  //Relative touch pin: tclk, tcs, din, dout, irq
extern uint8_t SmallFont[];
extern uint8_t BigFont[];
int backlight = 11, BACKLIGHT_VALUE=250;
int CONTRAST_VALUE = 64;
String notification_1, notification_2;
String connection_status, username, chargeStatus;
int HOME_PAGE = 0, SETTINGS_PAGE = 1, APP_PAGE = 2, ACTUAL_PAGE=-1;
int DISPLAY_OFF=0, DISPLAY_ON = 1, DISPLAY_STATUS=-1;
int BLUE = 1, BLACK = 2, backColor = BLACK;
SoftwareSerial mySerial(12, 13); // RX, TX

void setup()
{
  myGLCD.InitLCD();
  myGLCD.clrScr();
  myGLCD.setFont(SmallFont);

  myTouch.InitTouch();
  myTouch.setPrecision(PREC_MEDIUM);
  myGLCD.setBackColor(VGA_BLACK);
  myGLCD.setColor(VGA_WHITE);

  pinMode(backlight, OUTPUT);
  analogWrite(backlight, BACKLIGHT_VALUE);
  getInfoFromDevice();
  drawHome();  
}

void loop()
{
  if(myTouch.dataAvailable() || mySerial.available()){
    while (myTouch.dataAvailable()==true){
      myTouch.read();
      long x = myTouch.getX();
      long y = 240-myTouch.getY();
      if(DISPLAY_STATUS==DISPLAY_OFF){
        drawHome(); 
        powerOn();
        DISPLAY_STATUS=DISPLAY_ON;
        delay(1000);
        continue;  
      }
      if (clickInBox(x,y,278,199,318,236)){  //home button
        drawHome();
        ACTUAL_PAGE = HOME_PAGE;
        continue;
      }
      if (ACTUAL_PAGE == HOME_PAGE){
        if(clickInBox(x,y,216,20,316,100)==true){  //standby
          DISPLAY_STATUS=DISPLAY_OFF;
          standby();
          delay(1000);
          continue; 
        }
        if (clickInBox(x,y,3,20,103,100)==true){  //settings
          drawSettings();
          ACTUAL_PAGE = SETTINGS_PAGE;
          continue; 
        }
        if (clickInBox(x,y,109,20,210,100)==true){  //app
          drawApp();
          ACTUAL_PAGE = APP_PAGE;
          continue; 
        }
        if (clickInBox(x,y,3,103,318,189)==true){  //Hour
          refreshHour();
          continue; 
        }
      }       
      if (ACTUAL_PAGE == SETTINGS_PAGE){
        if (clickInBox(x,y,172,45,193,64)==true){  //+ backlight
          if (BACKLIGHT_VALUE <250){
            BACKLIGHT_VALUE += 25;
            analogWrite(backlight,BACKLIGHT_VALUE);
            delay(500);
          }
          continue; 
        }
        if (clickInBox(x,y,201,45,222,64)==true){  //- backlight
          if (BACKLIGHT_VALUE >=25){
            BACKLIGHT_VALUE -= 25;
            analogWrite(backlight,BACKLIGHT_VALUE);
            delay(500);
          }
          continue; 
        }
        if (clickInBox(x,y,232,45,283,64)==true){  //auto backlight
          continue; 
        }
        if (clickInBox(x,y,172,86,193,106)==true){  //+ contrast
          if (CONTRAST_VALUE<64){
           CONTRAST_VALUE += 8;
           myGLCD.setContrast(CONTRAST_VALUE);
          }
          continue; 
        }
        if (clickInBox(x,y,201,86,222,106)==true){  //- contrast
          if (CONTRAST_VALUE>0){
           CONTRAST_VALUE -= 8;
           myGLCD.setContrast(CONTRAST_VALUE);
          }
          continue; 
        }
        if (clickInBox(x,y,260,130,285,147)==true){  //blue back color
          backColor = BLUE;
          drawSettings();
          continue; 
        }
        if (clickInBox(x,y,202,130,228,147)==true){  //black back color
          backColor = BLACK;
          drawSettings();
          continue; 
        }
        if (clickInBox(x,y,30,170,122,190)==true){  //about
          continue; 
        }
      }
      if (ACTUAL_PAGE == APP_PAGE){

      }
    }    
    if(mySerial.available()==true){

    }
  }
}

void standby(){
  analogWrite(backlight,0);
  myGLCD.clrScr();
}

void powerOn(){
  analogWrite(backlight,BACKLIGHT_VALUE);  
}

void drawHome(){
  //xmax = 320
  //ymax = 240
  //Grey Button
  if (backColor = BLACK)
    myGLCD.fillScr(VGA_BLACK);
  else
    myGLCD.fillScr(VGA_BLUE);
  drawHeader();

  //settings rectangle
  myGLCD.setColor(255,127,39);
  myGLCD.fillRect(3,20,103,100);
  myGLCD.setColor(VGA_BLACK);
  myGLCD.setBackColor(255,127,39);
  myGLCD.setFont(SmallFont);
  myGLCD.print("Impostazioni",6,52);

  //App rectangle
  myGLCD.setColor(63,72,204);
  myGLCD.fillRect(109,20,210,100);
  myGLCD.setColor(VGA_WHITE);
  myGLCD.setBackColor(63,72,204);
  myGLCD.setFont(BigFont);
  myGLCD.print("APP",135,55);

  //Standby rectangle
  myGLCD.setColor(237,28,36);
  myGLCD.fillRect(216,20,316,100);
  myGLCD.setColor(VGA_BLACK);
  myGLCD.setBackColor(237,28,36);
  myGLCD.setFont(SmallFont);
  myGLCD.print("Standby",238,52);

  //hour-temp
  myGLCD.setColor(VGA_WHITE);
  myGLCD.setBackColor(VGA_BLACK);
  myGLCD.setFont(BigFont);
  myGLCD.print(getHour(),180,125);
  myGLCD.print(getTemp(),180,147);
  myGLCD.setFont(SmallFont);
  myGLCD.print("gradi",250,150);
  myGLCD.print(getDay(),50,125);
  myGLCD.print(getDate(),50,147);
  myGLCD.print("Clicca per aggiornare",80,168);

  drawFooter();
}

void drawSettings(){  
  if (backColor = BLACK)
    myGLCD.fillScr(VGA_BLACK);
  else
    myGLCD.fillScr(VGA_BLUE);
  drawHeader();
  myGLCD.setColor(VGA_BLACK);
  myGLCD.setFont(SmallFont);
  myGLCD.fillRect(3,20,316,186);
  myGLCD.setBackColor(VGA_BLACK);
  myGLCD.setColor(VGA_WHITE);  
  myGLCD.print("Luminosita'",33,49);
  myGLCD.print("Contrasto",33,89);
  myGLCD.print("Colore di sfondo",33,129);
  myGLCD.print("About",33,169);

  myGLCD.setBackColor(VGA_WHITE); 
  //backlight
  myGLCD.fillRect(172,45,193,64);
  myGLCD.fillRect(201,45,222,64);
  myGLCD.fillRect(232,45,283,64);

  //Contrast  
  myGLCD.fillRect(172,86,193,106);
  myGLCD.fillRect(201,86,222,106);

  //Back Color
  myGLCD.fillRect(191,128,296,149);
  myGLCD.setColor(VGA_BLACK); 
  myGLCD.fillRect(202,130,228,147);
  myGLCD.setColor(VGA_BLUE); 
  myGLCD.fillRect(260,130,285,147);

  //+ and -
  myGLCD.setBackColor(VGA_WHITE); 
  myGLCD.setColor(VGA_BLACK); 
  myGLCD.print("+",181,49);
  myGLCD.print("-",210,49);
  myGLCD.print("auto",241,49);
  myGLCD.print("+",181,91);
  myGLCD.print("-",210,90);  
  
  drawFooter();
}

void drawApp(){

}

void refreshHour(){

}

//This method requires in input 2 point of a box(high-left point and low-right point)
//to check if touch press is in box
boolean clickInBox(long x, long y, int high_x, int high_y, int low_x, int low_y){
  if (x>=high_x && x<=low_x && y>=high_y && y<=low_y)
    return true;
  return false;
}  

void drawHeader(){
  getInfoFromDevice();
  //serial control for connection, username and charge status
  myGLCD.setBackColor(VGA_BLACK);
  myGLCD.setColor(VGA_WHITE);
  myGLCD.setFont(SmallFont);

  myGLCD.print(connection_status,3,3);
  myGLCD.print(username,135,3);
  myGLCD.print(chargeStatus,250,3);
}

void drawFooter(){
  refreshNotification_s();
  //serial control to get notification from lumia device  

  //

  myGLCD.setFont(SmallFont);

  //print notification_s
  myGLCD.print(notification_1,3,200);
  myGLCD.print(notification_2,3,220);


  //home button
  myGLCD.setBackColor(VGA_WHITE);
  myGLCD.fillRect(278,199,318,236);
  myGLCD.drawBitmap(285,204,28,28,_home);
}

//serial hour request
String getHour(){
  //request

  //
  return "11:30";
}

//serial temp request
String getTemp(){
  //request

  //
  return "27.5";
}

String getDate(){
  //request

  //
  return "16/08/2014";
}

String getDay(){
  //request

  //
  return "Domenica";
}

//get notification from serial
void refreshNotification_s(){
  //request for notification

  //
  notification_1 = "1 chiam. persa - +393921585072";
  notification_2 = "1 mail - Facebook: Luigia Leo";
}

void getInfoFromDevice(){
  //serial request for status

  //
  backColor = 2;  //from bluetooth
  CONTRAST_VALUE = 30;
  connection_status="Disconnesso", username="Simone", chargeStatus="Batteria";
  if (backColor==BLUE){
    myGLCD.fillScr(VGA_BLUE);
  }    
  else if(backColor==BLACK){    
    myGLCD.fillScr(VGA_BLACK);
  } 
  analogWrite(backlight,  BACKLIGHT_VALUE);
  myGLCD.setContrast(CONTRAST_VALUE);
}





